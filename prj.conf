## CMakeLists.txt
```
# Find Zephyr. This also loads Zephyr's build system.
cmake_minimum_required(VERSION 3.13.1)
find_package(Zephyr REQUIRED HINTS $ENV{ZEPHYR_BASE})
project(blething)

# Add your source file to the "app" target. This must come after
# find_package(Zephyr) which defines the target.
target_sources(app PRIVATE src/main.c src/hog.c src/usb.c src/serial.c)
```

## prj.conf
```kconfig
CONFIG_BT=y
CONFIG_BT_DEBUG_LOG=y
CONFIG_BT_DEVICE_NAME="GCK-IO"
CONFIG_BT_PERIPHERAL=y
CONFIG_BT_MAX_PAIRED=6
CONFIG_BT_MAX_CONN=6
CONFIG_BT_BONDABLE=y
CONFIG_BT_SETTINGS=y
CONFIG_BT_SMP=y
CONFIG_GPIO=y

CONFIG_FLASH=y
CONFIG_FLASH_PAGE_LAYOUT=y
CONFIG_FLASH_MAP=y
CONFIG_FCB=y
CONFIG_SETTINGS=y
CONFIG_SETTINGS_FCB=y

CONFIG_NRFX_WDT=y
CONFIG_NRFX_WDT0=y

CONFIG_USB=y
CONFIG_USB_DEVICE_STACK=y
CONFIG_USB_COMPOSITE_DEVICE=y
CONFIG_USB_CDC_ACM=y
CONFIG_USB_DEVICE_HID=y
CONFIG_USB_HID_BOOT_PROTOCOL=y
CONFIG_ENABLE_HID_INT_OUT_EP=n
CONFIG_USB_HID_LOG_LEVEL_DBG=y
CONFIG_USB_HID_REPORTS=2
CONFIG_USB_HID_PROTOCOL_CODE=1
CONFIG_USB_DEVICE_PRODUCT="GCK-IO"

CONFIG_UART_INTERRUPT_DRIVEN=y

CONFIG_SERIAL=y
CONFIG_UART_INTERRUPT_DRIVEN=y
CONFIG_UART_LINE_CTRL=y

CONFIG_STACK_SENTINEL=y

CONFIG_THREAD_STACK_INFO=y
CONFIG_THREAD_MONITOR=y
CONFIG_KERNEL_SHELL=y
CONFIG_INIT_STACKS=y
CONFIG_THREAD_NAME=y

CONFIG_SYSTEM_WORKQUEUE_STACK_SIZE=2048
CONFIG_MAIN_STACK_SIZE=1536

CONFIG_SHELL=y
CONFIG_BT_SHELL=y

CONFIG_UART_SHELL_ON_DEV_NAME="CDC_ACM_0"

CONFIG_BOOT_BANNER=n

# qspi NOR driver
# CONFIG_NORDIC_QSPI_NOR=y
# CONFIG_NORDIC_QSPI_NOR_FLASH_LAYOUT_PAGE_SIZE=4096

# # mass storage
# CONFIG_MASS_STORAGE_DISK_NAME="NAND"

# # disk
# CONFIG_DISK_ACCESS_FLASH=y
# CONFIG_DISK_FLASH_DEV_NAME="MX25R64"
# CONFIG_DISK_FLASH_START=0x0
# CONFIG_DISK_VOLUME_SIZE=0x4000000
# CONFIG_DISK_FLASH_MAX_RW_SIZE=4096
# CONFIG_DISK_FLASH_ERASE_ALIGNMENT=0x1000
# CONFIG_DISK_ERASE_BLOCK_SIZE=0x1000

# # file system
# CONFIG_FILE_SYSTEM=y
# CONFIG_FAT_FILESYSTEM_ELM=y
```

## boards/nrf52840_mdk.overlay
```dts
// using an mx25r64
// &mx25r64 {
//   partitions {
//     compatible = "fixed-partitions";
//     #address-cells = <1>;
//     #size-cells = <1>;
//     partition@0 {
//       label = "qspi";
//       reg = <0x00000000 0x04000000>;
//     };
//   };
// };
```

## src/main.c
```c
#include <zephyr.h>

#include <settings/settings.h>

#include <bluetooth/bluetooth.h>
#include <bluetooth/hci.h>
#include <bluetooth/conn.h>
#include <bluetooth/uuid.h>
#include <bluetooth/gatt.h>

#include <drivers/uart.h>
#include <drivers/led.h>

#include <drivers/gpio.h>
#include <logging/log.h>

#include <sys/ring_buffer.h>

#include "hog.h"
#include "usb.h"
#include "serial.h"

LOG_MODULE_REGISTER(main, LOG_LEVEL_INF);

static const struct bt_data ad[] = {
	BT_DATA_BYTES(BT_DATA_FLAGS, (BT_LE_AD_GENERAL | BT_LE_AD_NO_BREDR)),
	BT_DATA_BYTES(BT_DATA_UUID16_ALL,
		      0x12, 0x18, /* HID Service */
		      0x0f, 0x18), /* Battery Service */
};

const struct device *gpio_dev;

static void connected(struct bt_conn *conn, uint8_t err)
{
	char addr[BT_ADDR_LE_STR_LEN];

	bt_addr_le_to_str(bt_conn_get_dst(conn), addr, sizeof(addr));

	if (err) {
		LOG_ERR("Failed to connect to %s (%u)", log_strdup(addr), err);
		return;
	}

	LOG_INF("Connected %s", log_strdup(addr));

	if (bt_conn_set_security(conn, BT_SECURITY_L2)) {
		LOG_ERR("Failed to set security");
	}
}

static void disconnected(struct bt_conn *conn, uint8_t reason)
{
	char addr[BT_ADDR_LE_STR_LEN];

	bt_addr_le_to_str(bt_conn_get_dst(conn), addr, sizeof(addr));

	LOG_INF("Disconnected from %s (reason 0x%02x)", log_strdup(addr), reason);
}

static void security_changed(struct bt_conn *conn, bt_security_t level,
			     enum bt_security_err err)
{
	char addr[BT_ADDR_LE_STR_LEN];

	bt_addr_le_to_str(bt_conn_get_dst(conn), addr, sizeof(addr));

	if (!err) {
		LOG_INF("Security changed: %s level %u", log_strdup(addr), level);
	} else {
		LOG_ERR("Security failed: %s level %u err %d", log_strdup(addr), level,
		       err);
	}
}

static struct bt_conn_cb conn_callbacks = {
	.connected = connected,
	.disconnected = disconnected,
	.security_changed = security_changed,
};

void bt_ready(int err) {
    if (err) {
        LOG_ERR("Bluetooth init failed %d", err);
        return;
    }
    
    hog_init();

    // Load settings - including pairing info
    settings_load();

    LOG_INF("Bluetooth initialized");


    err = bt_le_adv_start(BT_LE_ADV_CONN_NAME, ad, ARRAY_SIZE(ad), NULL, 0);
	if (err) {
		LOG_ERR("Advertising failed to start (err %d)", err);
		return;
	}

    LOG_INF("Advertising successfully started");
}

static void auth_passkey_display(struct bt_conn *conn, unsigned int passkey)
{
	char addr[BT_ADDR_LE_STR_LEN];

	bt_addr_le_to_str(bt_conn_get_dst(conn), addr, sizeof(addr));

	LOG_INF("Passkey for %s: %06u", log_strdup(addr), passkey);
}

static void auth_cancel(struct bt_conn *conn)
{
	char addr[BT_ADDR_LE_STR_LEN];

	bt_addr_le_to_str(bt_conn_get_dst(conn), addr, sizeof(addr));

	LOG_INF("Pairing cancelled: %s", log_strdup(addr));
}

static struct bt_conn_auth_cb auth_cb_display = {
	.passkey_display = auth_passkey_display,
	.passkey_entry = NULL,
	.cancel = auth_cancel,
};

struct k_timer my_timer;

uint8_t toggle = 0;

void my_timer_expiry(struct k_timer *timer_id) {
	const char *data = "Hello\r\n";
	int ret;

	// ret = uart_send((uint8_t *)data, strlen(data));

	// if (ret <= 0) {
	// 	LOG_ERR("Failed to uart_send %d", ret);
	// }
	// if (toggle) {
	// 	hog_input_keys(0x04);
	// 	usb_input_keys(0x04);
	// } else {
	// 	hog_input_keys(0x00);
	// 	usb_input_keys(0x00);
	// }
	// toggle = ! toggle;
}

void scan_thread() {
	while (true) {
		// hog_input_keys(0x53);
		// usb_input_keys(0x53);
		// k_sleep(K_MSEC(10));
		// hog_input_keys(0x00);
		// usb_input_keys(0x00);
		k_sleep(K_MSEC(5000));
	}
}

void main(void) {
    int err;

	uart_init();

    if ((err = bt_enable(bt_ready))) {
        LOG_INF("Bluetooth init failed %d", err);
        return;
    }

	bt_conn_cb_register(&conn_callbacks);
	bt_conn_auth_cb_register(&auth_cb_display);

	usb_init();

	gpio_dev = device_get_binding("GPIO_0");
	if (!gpio_dev) {
		LOG_INF("No GPIO device");
		return;
	}
	gpio_pin_configure(gpio_dev, 22, GPIO_OUTPUT); //p0.22 == Green
	gpio_pin_configure(gpio_dev, 23, GPIO_OUTPUT); //p0.23 == Red
	gpio_pin_configure(gpio_dev, 24, GPIO_OUTPUT); //p0.24 == Blue

	gpio_pin_set(gpio_dev, 22, 1);
	gpio_pin_set(gpio_dev, 23, 1);
	// gpio_pin_set(gpio_dev, 24, 1);

    k_timer_init(&my_timer, my_timer_expiry, NULL);
    k_timer_start(&my_timer, K_MSEC(1000), K_MSEC(1000));

	int timer = 0;
	while(true) {
		k_sleep(K_MSEC(1));
		if (!ring_buf_is_empty(&rxring)) {
			uint8_t buf[16];
			int len;

			len = ring_buf_get(&rxring, buf, sizeof(buf));
			if (len <= 0) continue;
			uart_send(buf, len);
		}
	}
}

K_THREAD_DEFINE(scan_thread_id, 1024, scan_thread, NULL, NULL, NULL, 7, 0, 0);
```

## src/hid.h
```c
#include <zephyr.h>
#include <usb/class/usb_hid.h>

#pragma once

struct hid_report {
    uint8_t modifier;
    uint8_t unused;
    uint8_t codes[6];
} __packed;
```

## src/hog.c
```c
/** @file
 *  @brief HoG Service sample
 */

/*
 * Copyright (c) 2016 Intel Corporation
 *
 * SPDX-License-Identifier: Apache-2.0
 */

#include <zephyr/types.h>
#include <stddef.h>
#include <string.h>
#include <errno.h>
#include <sys/byteorder.h>
#include <zephyr.h>

#include <bluetooth/bluetooth.h>
#include <bluetooth/hci.h>
#include <bluetooth/conn.h>
#include <bluetooth/uuid.h>
#include <bluetooth/gatt.h>

#include <logging/log.h>

#include "hog.h"

LOG_MODULE_REGISTER(hog, LOG_LEVEL_INF);

enum {
	HIDS_REMOTE_WAKE = BIT(0),
	HIDS_NORMALLY_CONNECTABLE = BIT(1),
};

struct hids_info {
	uint16_t version; /* version number of base USB HID Specification */
	uint8_t code; /* country HID Device hardware is localized for. */
	uint8_t flags;
} __packed;

struct hids_report {
	uint8_t id; /* report id */
	uint8_t type; /* report type */
} __packed;

static struct hids_info info = {
	.version = 0x0101,
	.code = 0x00,
	.flags = HIDS_NORMALLY_CONNECTABLE,
};

enum {
	HIDS_INPUT = 0x01,
	HIDS_OUTPUT = 0x02,
	HIDS_FEATURE = 0x03,
};

static const char *manufacturer = "GothAck";
static const uint8_t pnp_id[] = {
    0x02,
    0x6d,
    0x04,
    0x5b,
    0xb3,
    0x11,
    0x00,
};

static uint8_t input_report[8] = {0};
static uint8_t output_report[20] = {0};
static uint8_t feature_report[2] = {0};

static struct hids_report input = {
	.id = 0x01,
	.type = HIDS_INPUT,
};

static struct hids_report output = {
    .id = 0x02,
    .type = HIDS_OUTPUT,
};

static struct hids_report feature = {
    .id = 0x03,
    .type = HIDS_FEATURE,
};

uint8_t simulate_input;
static uint8_t ctrl_point;
static uint8_t report_map[] = {
    0x05, 0x01,                 // Usage Page (Generic Desktop)
    0x09, 0x06,                 // Usage (Keyboard)
    0xA1, 0x01,                 // Collection (Application)
    0x05, 0x07,                 //     Usage Page (Key Codes)
    0x19, 0xe0,                 //     Usage Minimum (224)
    0x29, 0xe7,                 //     Usage Maximum (231)
    0x15, 0x00,                 //     Logical Minimum (0)
    0x25, 0x01,                 //     Logical Maximum (1)
    0x95, 0x08,                 //     Report Count (8)
    0x75, 0x01,                 //     Report Size (1)
    0x81, 0x02,                 //     Input (Data, Variable, Absolute)

    0x95, 0x01,                 //     Report Count (1)
    0x75, 0x08,                 //     Report Size (8)
    0x81, 0x01,                 //     Input (Constant) reserved byte(1)

    0x95, 0x05,                 //     Report Count (5)
    0x75, 0x01,                 //     Report Size (1)
    0x05, 0x08,                 //     Usage Page (Page# for LEDs)
    0x19, 0x01,                 //     Usage Minimum (1)
    0x29, 0x05,                 //     Usage Maximum (5)
    0x91, 0x02,                 //     Output (Data, Variable, Absolute), Led report
    0x95, 0x01,                 //     Report Count (1)
    0x75, 0x03,                 //     Report Size (3)
    0x91, 0x01,                 //     Output (Data, Variable, Absolute), Led report padding

    0x95, 0x06,                 //     Report Count (6)
    0x75, 0x08,                 //     Report Size (8)
    0x15, 0x00,                 //     Logical Minimum (0)
    0x25, 0x65,                 //     Logical Maximum (101)
    0x05, 0x07,                 //     Usage Page (Key codes)
    0x19, 0x00,                 //     Usage Minimum (0)
    0x29, 0x65,                 //     Usage Maximum (101)
    0x81, 0x00,                 //     Input (Data, Array) Key array(6 bytes)

    0x09, 0x05,                 //     Usage (Vendor Defined)
    0x15, 0x00,                 //     Logical Minimum (0)
    0x26, 0xFF, 0x00,           //     Logical Maximum (255)
    0x95, 0x02,                 //     Report Count (2)
    0x75, 0x08,                 //     Report Size (8 bit)
    0xB1, 0x02,                 //     Feature (Data, Variable, Absolute)

    0xC0,                       // End Collection (Application)
};

static ssize_t read_info(struct bt_conn *conn,
			  const struct bt_gatt_attr *attr, void *buf,
			  uint16_t len, uint16_t offset)
{
    LOG_INF("read_info");
	return bt_gatt_attr_read(conn, attr, buf, len, offset, attr->user_data,
				 sizeof(struct hids_info));
}

static ssize_t read_dis_pnp_id(struct bt_conn *conn,
			  const struct bt_gatt_attr *attr, void *buf,
			  uint16_t len, uint16_t offset)
{
    LOG_INF("read_dis_pnp_id");
	return bt_gatt_attr_read(conn, attr, buf, len, offset, attr->user_data,
				 sizeof(pnp_id));
}

static ssize_t read_dis_manu_name(struct bt_conn *conn,
			  const struct bt_gatt_attr *attr, void *buf,
			  uint16_t len, uint16_t offset)
{
    LOG_INF("read_dis_manu_name");
	return bt_gatt_attr_read(conn, attr, buf, len, offset, manufacturer,
				 strlen(manufacturer));
}

static uint8_t bas_level = 0x32;

static ssize_t read_bas_level(struct bt_conn *conn,
			  const struct bt_gatt_attr *attr, void *buf,
			  uint16_t len, uint16_t offset)
{
    LOG_INF("read_dis_manu_name");
	return bt_gatt_attr_read(conn, attr, buf, len, offset, attr->user_data,
				 sizeof(bas_level));
}

static ssize_t read_report_map(struct bt_conn *conn,
			       const struct bt_gatt_attr *attr, void *buf,
			       uint16_t len, uint16_t offset)
{
    LOG_INF("read_report_map");
	return bt_gatt_attr_read(conn, attr, buf, len, offset, report_map,
				 sizeof(report_map));
}

static ssize_t read_report(struct bt_conn *conn,
			   const struct bt_gatt_attr *attr, void *buf,
			   uint16_t len, uint16_t offset)
{
    struct hids_report *report = (struct hids_report *)attr->user_data;
    LOG_INF("read_report %d %d", report->id, report->type);
	return bt_gatt_attr_read(conn, attr, buf, len, offset, attr->user_data,
				 sizeof(struct hids_report));
}

static void input_ccc_changed(const struct bt_gatt_attr *attr, uint16_t value)
{
    LOG_INF("input_ccc_changed %x", value);
	simulate_input = (value == BT_GATT_CCC_NOTIFY) ? 1 : 0;
}

static void output_ccc_changed(const struct bt_gatt_attr *attr, uint16_t value)
{
    LOG_INF("output_ccc_changed %x", value);
}

static ssize_t read_input_report(struct bt_conn *conn,
				 const struct bt_gatt_attr *attr, void *buf,
				 uint16_t len, uint16_t offset)
{
    LOG_INF("read_input_report");
	return bt_gatt_attr_read(conn, attr, buf, len, offset, attr->user_data, sizeof(input_report));
}

static ssize_t read_output_report(struct bt_conn *conn,
				 const struct bt_gatt_attr *attr, void *buf,
				 uint16_t len, uint16_t offset)
{
    LOG_INF("read_output_report");
	return bt_gatt_attr_read(conn, attr, buf, len, offset, attr->user_data, sizeof(output_report));
}

static ssize_t write_output_report(struct bt_conn *conn,
				const struct bt_gatt_attr *attr,
				const void *buf, uint16_t len, uint16_t offset,
				uint8_t flags)
{
    LOG_INF("write_output_report %d %d", len, offset);
	uint8_t *value = attr->user_data;

	if (offset + len > sizeof(output_report)) {
		return BT_GATT_ERR(BT_ATT_ERR_INVALID_OFFSET);
	}

	memcpy(value + offset, buf, len);

    if (output_report[0] & 0x01) {
        LOG_INF("Num lock ON");
    } else {
        LOG_INF("Num lock OFF");
    }
    if (output_report[0] & 0x02) {
        LOG_INF("Caps lock ON");
    } else {
        LOG_INF("Caps lock OFF");
    }

	return len;
}

static ssize_t read_feature_report(struct bt_conn *conn,
				 const struct bt_gatt_attr *attr, void *buf,
				 uint16_t len, uint16_t offset)
{
    LOG_INF("read_feature_report");
	return bt_gatt_attr_read(conn, attr, buf, len, offset, attr->user_data, sizeof(feature_report));
}

static ssize_t write_feature_report(struct bt_conn *conn,
				const struct bt_gatt_attr *attr,
				const void *buf, uint16_t len, uint16_t offset,
				uint8_t flags)
{
    LOG_INF("write_feature_report %d %d", len, offset);
	uint8_t *value = attr->user_data;

	if (offset + len > sizeof(feature_report)) {
		return BT_GATT_ERR(BT_ATT_ERR_INVALID_OFFSET);
	}

	memcpy(value + offset, buf, len);

	return len;
}

static ssize_t write_ctrl_point(struct bt_conn *conn,
				const struct bt_gatt_attr *attr,
				const void *buf, uint16_t len, uint16_t offset,
				uint8_t flags)
{
    LOG_INF("write_ctrl_point");
	uint8_t *value = attr->user_data;

	if (offset + len > sizeof(ctrl_point)) {
		return BT_GATT_ERR(BT_ATT_ERR_INVALID_OFFSET);
	}

	memcpy(value + offset, buf, len);

	return len;
}

/* Device Info Service Declaration */
BT_GATT_SERVICE_DEFINE(dis_svc,
	BT_GATT_PRIMARY_SERVICE(BT_UUID_DIS),
	BT_GATT_CHARACTERISTIC(BT_UUID_DIS_PNP_ID, BT_GATT_CHRC_READ,
			       BT_GATT_PERM_READ, read_dis_pnp_id, NULL, &pnp_id),
	BT_GATT_CHARACTERISTIC(BT_UUID_DIS_MANUFACTURER_NAME, BT_GATT_CHRC_READ,
			       BT_GATT_PERM_READ, read_dis_manu_name, NULL, NULL),
);

/* Battery Service Declaration */
BT_GATT_SERVICE_DEFINE(bas_svc,
	BT_GATT_PRIMARY_SERVICE(BT_UUID_BAS),
	BT_GATT_CHARACTERISTIC(BT_UUID_BAS_BATTERY_LEVEL, BT_GATT_CHRC_READ | BT_GATT_CHRC_NOTIFY,
			       BT_GATT_PERM_READ, read_bas_level, NULL, &bas_level),
	BT_GATT_CCC(NULL,
		    BT_GATT_PERM_READ | BT_GATT_PERM_WRITE),
);

/* HID Service Declaration */
BT_GATT_SERVICE_DEFINE(hog_svc,
	BT_GATT_PRIMARY_SERVICE(BT_UUID_HIDS),
	BT_GATT_CHARACTERISTIC(BT_UUID_HIDS_INFO, BT_GATT_CHRC_READ,
			       BT_GATT_PERM_READ, read_info, NULL, &info),
	BT_GATT_CHARACTERISTIC(BT_UUID_HIDS_REPORT_MAP, BT_GATT_CHRC_READ,
			       BT_GATT_PERM_READ, read_report_map, NULL, NULL),
	BT_GATT_CHARACTERISTIC(BT_UUID_HIDS_REPORT,
			       BT_GATT_CHRC_READ | BT_GATT_CHRC_NOTIFY,
			       BT_GATT_PERM_READ_ENCRYPT,
			       read_input_report, NULL, &input_report),
	BT_GATT_CCC(input_ccc_changed,
		    BT_GATT_PERM_READ_ENCRYPT | BT_GATT_PERM_WRITE_ENCRYPT),
	BT_GATT_DESCRIPTOR(BT_UUID_HIDS_REPORT_REF, BT_GATT_PERM_READ,
			   read_report, NULL, &input),
	BT_GATT_CHARACTERISTIC(BT_UUID_HIDS_REPORT,
			       BT_GATT_CHRC_READ | BT_GATT_CHRC_WRITE | BT_GATT_CHRC_WRITE_WITHOUT_RESP,
			       BT_GATT_PERM_READ_ENCRYPT | BT_GATT_PERM_WRITE_ENCRYPT,
			       read_output_report, write_output_report, &output_report),
	BT_GATT_DESCRIPTOR(BT_UUID_HIDS_REPORT_REF, BT_GATT_PERM_READ,
			   read_report, NULL, &output),
	BT_GATT_CHARACTERISTIC(BT_UUID_HIDS_REPORT,
			       BT_GATT_CHRC_READ | BT_GATT_CHRC_WRITE | BT_GATT_CHRC_WRITE_WITHOUT_RESP,
			       BT_GATT_PERM_READ_ENCRYPT | BT_GATT_PERM_WRITE_ENCRYPT,
			       read_feature_report, write_feature_report, &feature_report),
	BT_GATT_DESCRIPTOR(BT_UUID_HIDS_REPORT_REF, BT_GATT_PERM_READ,
			   read_report, NULL, &feature),
	BT_GATT_CHARACTERISTIC(BT_UUID_HIDS_CTRL_POINT,
			       BT_GATT_CHRC_WRITE_WITHOUT_RESP,
			       BT_GATT_PERM_WRITE,
			       NULL, write_ctrl_point, &ctrl_point),
);

void hog_input_keys(uint8_t k0) {
    input_report[2] = k0;
    int err = bt_gatt_notify(NULL, &hog_svc.attrs[5], &input_report, sizeof(input_report));
    if (err)
        LOG_ERR("Gatt notify error %d", err);
}

void hog_init(void)
{
}
```

## src/hog.h
```c
#pragma once

void hog_init(void);

extern uint8_t simulate_input;

void hog_input_keys(uint8_t k0);
```

## src/serial.c
```c
#include <drivers/uart.h>
#include <logging/log.h>
#include <sys/ring_buffer.h>

#include "serial.h"

LOG_MODULE_REGISTER(serial, LOG_LEVEL_INF);

const struct device *uart_dev;

struct ring_buf rxring;
uint8_t rxring_buf[256];
struct ring_buf txring;
uint8_t txring_buf[256];

static void interrupt_handler(const struct device *dev, void *user_data)
{
    ARG_UNUSED(user_data);

    while (uart_irq_update(dev) && uart_irq_is_pending(dev)) {
        if (uart_irq_rx_ready(dev)) {
            int recv_len, rb_len;
            uint8_t buf[16];
            size_t len = MIN(ring_buf_space_get(&rxring), sizeof(buf));

            recv_len = uart_fifo_read(dev, buf, len);

            rb_len = ring_buf_put(&rxring, buf, recv_len);

            if (rb_len < recv_len) {
                LOG_WRN("Dropped %d rx bytes", recv_len - rb_len);
            }
        }
        if (uart_irq_tx_ready(dev)) {
            uint8_t buf[1];
            int rb_len, send_len;

            rb_len = ring_buf_get(&txring, buf, sizeof(buf));
            if (!rb_len) {
                uart_irq_tx_disable(dev);
                continue;
            }

            send_len = uart_fifo_fill(dev, buf, rb_len);

            if (send_len < rb_len) {
                LOG_WRN("Dropped %d tx bytes", rb_len - send_len);
            }
        }

    }
}


void uart_init() {
    ring_buf_init(&rxring, sizeof(rxring_buf), rxring_buf);
    ring_buf_init(&txring, sizeof(txring_buf), txring_buf);

	uart_dev = device_get_binding("UART_0");
	if (!uart_dev) {
		LOG_INF("No UART device");
		return;
	}

	uart_irq_callback_set(uart_dev, interrupt_handler);

	/* Enable rx interrupts */
	uart_irq_rx_enable(uart_dev);
}

int uart_send(uint8_t *data, uint16_t len) {
    int ret = ring_buf_put(&txring, data, len);
    uart_irq_tx_enable(uart_dev);
    return ret;
}
```

## src/serial.h
```c
#pragma once

extern struct ring_buf rxring;
extern struct ring_buf txring;

void uart_init();

int uart_send(uint8_t *data, uint16_t len);
```

## src/usb.c
```c
#include <usb/usb_device.h>
#include <usb/class/usb_hid.h>
#include <usb/class/usb_cdc.h>

#include <logging/log.h>

#include "usb.h"
#include "hid.h"

LOG_MODULE_REGISTER(usb, LOG_LEVEL_INF);

static const uint8_t hid_kbd_report_desc[] = HID_KEYBOARD_REPORT_DESC();

const struct device *hid0_dev, *cdc0_dev;

struct ring_buf rxring;
uint8_t rxring_buf[sizeof(struct hid_report) * 32];
static K_SEM_DEFINE(usb_sem, 1, 1);	/* starts off "available" */

static void in_ready_cb(const struct device *dev)
{
	ARG_UNUSED(dev);

	k_sem_give(&usb_sem);
}

static int in_set_report_cb(const struct device *dev, struct usb_setup_packet *setup, int32_t *len, uint8_t **data) {
	LOG_INF("Set report %d %d %d %d %d", setup->bmRequestType, setup->bRequest, setup->wValue, setup->wIndex, setup->wLength);
	LOG_INF("Set report %d", *len);
	for (int i = 0; i < *len; ++i) {
		LOG_INF("%02x", *data[i]);
	}
	return 0;
}

static const struct hid_ops ops = {
	.set_report = in_set_report_cb,
	.int_in_ready = in_ready_cb,
};

static void status_cb(enum usb_dc_status_code status, const uint8_t *param)
{
	LOG_INF("Status %d", status);
}

void usb_init() {
    int ret;

    hid0_dev = device_get_binding("HID_0");
	if (hid0_dev == NULL) {
		LOG_ERR("Cannot get USB HID 0 Device");
		return;
	}

    cdc0_dev = device_get_binding("CDC_ACM_0");
	if (cdc0_dev == NULL) {
		LOG_ERR("Cannot get USB CDC 0 Device");
		return;
	}

	usb_hid_register_device(hid0_dev, hid_kbd_report_desc,
				sizeof(hid_kbd_report_desc), &ops);

	ret = usb_hid_init(hid0_dev);
	if (ret != 0) {
		LOG_ERR("Failed to enable USB HID %d", ret);
		return;
	}

	ret = usb_enable(status_cb);
	if (ret != 0) {
		LOG_ERR("Failed to enable USB %d", ret);
		return;
	}

    LOG_INF("USB Initialized");
}

void usb_loop() {

}

void usb_input_keys(struct hid_report report) {
    hid_int_ep_write(hid0_dev, (const uint8_t *)&report, sizeof(report), NULL);
}
```

## src/usb.h
```c
#include "hid.h"

#pragma once

void usb_init();

void usb_loop();

void usb_input_keys(struct hid_report report);
```
